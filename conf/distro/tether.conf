## conf/distro/tether.conf
```bitbake
require conf/distro/poky.conf

DISTRO = "tether"
DISTRO_NAME = "Tether Distro"
DISTRO_VERSION = "1.0"

INIT_MANAGER = "systemd"

# Ensure necessary distro features are included
DISTRO_FEATURES:append = " wayland pam systemd opengl usbhost wifi zeroconf"
# Remove unused distro features
DISTRO_FEATURES:remove = "x11 vulkan bluetooth alsa pulseaudio 3g nfc pcmcia usbgadget nfs ptest debuginfod multiarch"

# Enable DSI display auto-detection
RPI_EXTRA_CONFIG = "\ndisplay_auto_detect=1\n"

# Silent boot configuration
DISABLE_RPI_BOOT_LOGO = "1"
CMDLINE:append = " vt.global_cursor_default=0 quiet splash"

# Set the hostname
hostname:pn-base-files ?= "tetherpi"
```

## conf/layer.conf
```bitbake
# We have a conf and classes directory, add to BBPATH
BBPATH .= ":${LAYERDIR}"

# We have recipes-* directories, add to BBFILES
BBFILES += "${LAYERDIR}/recipes-*/*/*.bb \
            ${LAYERDIR}/recipes-*/*/*.bbappend"

BBFILE_COLLECTIONS += "meta-tether"
BBFILE_PATTERN_meta-tether = "^${LAYERDIR}/"
BBFILE_PRIORITY_meta-tether = "10"

# This layer depends on poky/meta, poky/meta-poky, meta-openembedded/meta-oe and meta-raspberrypi
LAYERDEPENDS_meta-tether = " \
    core \
    yocto \
    openembedded-layer \
    raspberrypi \
"
LAYERSERIES_COMPAT_meta-tether = "scarthgap"
```
